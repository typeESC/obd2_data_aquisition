## ESP32/sdkconfig.defaults
```kconfig
# Desabilita MQTT completamente
CONFIG_MQTT_PROTOCOL_311=n
CONFIG_MQTT_TRANSPORT_SSL=n
CONFIG_MQTT_TRANSPORT_WEBSOCKET=n
CONFIG_MQTT_TRANSPORT_WEBSOCKET_SECURE=n

# Enable FAT filesystem for SD Card
CONFIG_FATFS_LONG_FILENAME=y
CONFIG_FATFS_LFN_HEAP=y
CONFIG_FATFS_MAX_LFN=255
CONFIG_FATFS_API_ENCODING_ANSI_OEM=y
CONFIG_FATFS_CODEPAGE=850
CONFIG_FATFS_FS_LOCK=0
CONFIG_FATFS_TIMEOUT_MS=10000
CONFIG_FATFS_ALLOC_PREFER_EXTRAM=n

# SD Card SPI
CONFIG_SDSPI_ENABLED=y

# Optimize for performance
CONFIG_FREERTOS_HZ=1000
```
